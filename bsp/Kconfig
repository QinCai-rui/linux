## bsp/Kconfig
```kconfig
# SPDX-License-Identifier: GPL-2.0

menu "Allwinner BSP"

source "$(BSP_TOP)platform/Kconfig"
source "$(BSP_TOP)platform/Kconfig.debug"
source "$(BSP_TOP)drivers/Kconfig"

endmenu
```

## bsp/drivers/Kconfig
```kconfig
# SPDX-License-Identifier: GPL-2.0-only

menu "Device Drivers"

# Minimal System
source "$(BSP_TOP)drivers/clk/Kconfig"
source "$(BSP_TOP)drivers/pinctrl/Kconfig"
source "$(BSP_TOP)drivers/uart/Kconfig"
source "$(BSP_TOP)drivers/timer/Kconfig"

# Basic System
source "$(BSP_TOP)drivers/dma/Kconfig"
source "$(BSP_TOP)drivers/rtc/Kconfig"
source "$(BSP_TOP)drivers/bus/Kconfig"
source "$(BSP_TOP)drivers/dumpreg/Kconfig"
source "$(BSP_TOP)drivers/iommu/Kconfig"

# Storage
source "$(BSP_TOP)drivers/mmc/Kconfig"
source "$(BSP_TOP)drivers/ufs/Kconfig"
source "$(BSP_TOP)drivers/mtd/Kconfig"
source "$(BSP_TOP)drivers/redeposit/Kconfig"

# Graphics
source "$(BSP_TOP)drivers/g2d/Kconfig"
source "$(BSP_TOP)drivers/di/Kconfig"
source "$(BSP_TOP)drivers/vin/Kconfig"
source "$(BSP_TOP)drivers/vfe/Kconfig"
source "$(BSP_TOP)drivers/drm/Kconfig"

# Multi-Media
source "$(BSP_TOP)drivers/ve/Kconfig"

# Audio
source "$(BSP_TOP)drivers/sound/Kconfig"

# Security
source "$(BSP_TOP)drivers/ce/Kconfig"
source "$(BSP_TOP)drivers/smc/Kconfig"
source "$(BSP_TOP)drivers/sid/Kconfig"
source "$(BSP_TOP)drivers/drm_heap/Kconfig"

# I/O Connectivity
source "$(BSP_TOP)drivers/pcie/Kconfig"
source "$(BSP_TOP)drivers/phy/Kconfig"
source "$(BSP_TOP)drivers/gmac/Kconfig"
source "$(BSP_TOP)drivers/stmmac/Kconfig"
source "$(BSP_TOP)drivers/usb/Kconfig"
source "$(BSP_TOP)drivers/twi/Kconfig"
source "$(BSP_TOP)drivers/spi-ng/Kconfig"
source "$(BSP_TOP)drivers/pwm/Kconfig"
source "$(BSP_TOP)drivers/input/Kconfig"

# Wireless
source "$(BSP_TOP)drivers/net/Kconfig"

# Power Management
source "$(BSP_TOP)drivers/irqchip/Kconfig"
source "$(BSP_TOP)drivers/standby/Kconfig"
source "$(BSP_TOP)drivers/thermal/Kconfig"
source "$(BSP_TOP)drivers/nvmem/Kconfig"
source "$(BSP_TOP)drivers/pm_domain/Kconfig"
source "$(BSP_TOP)drivers/power/Kconfig"
source "$(BSP_TOP)drivers/cpufreq/Kconfig"
source "$(BSP_TOP)drivers/devfreq/Kconfig"

# Misc
source "$(BSP_TOP)drivers/misc/Kconfig"
endmenu
```

## bsp/drivers/drm/phy/Kconfig
```kconfig
# SPDX-License-Identifier: GPL-2.0-or-later

config AW_DRM_DSI_COMBOPHY
	tristate "LVDS and MIPI DSI Combophy"
	default n
	help
		If you want to support lvds dsi combophy, select it.
```

## bsp/drivers/iommu/Kconfig
```kconfig
# SPDX-License-Identifier: GPL-2.0-only
menu "IOMMU Drivers"
	depends on AW_BSP

config AW_IOMMU
       tristate "Allwinner IOMMU Support"
       depends on AW_BSP
       select ARM_DMA_USE_IOMMU if ARM
       select IOMMU_SUPPORT
       select IOMMU_API
       select IOMMU_DMA
       help
         Support for the Allwinner IOMMU(System MMU) component. This
         enables H/W multimedia accellerators to see non-linear physical
         memory chunks as a linear memory in their address spaces.

         If unsure, say N here.

if AW_IOMMU
choice
       prompt "IOMMU verson"
       default AW_IOMMU_V2

config AW_IOMMU_V2
       bool "V2"
endchoice

config AW_IOMMU_DISTRIBUTE
       bool "IOMMU is distribute"
       default n
       default y if AW_IOMMU_V2
endif

endmenu
```

## bsp/drivers/net/wireless/Kconfig
```kconfig
menu "Wireless LAN"
	depends on !S390
	depends on NET

if WLAN

source "$(BSP_TOP)drivers/net/wireless/aic8800/Kconfig"
endif

endmenu
```

## bsp/drivers/usb/typec/mux/Kconfig
```kconfig
# SPDX-License-Identifier: GPL-2.0

menu "USB Type-C Multiplexer/DeMultiplexer Switch support"

config TYPEC_MUX_PS8743
	tristate "Parade PS8743 Type-C cross switch driver"
	depends on USB_SUNXI_TYPEC
	depends on I2C
	help
	  Say Y or M if your system has a Parade PS8743 Type-C cross
	  switch / mux chip found on some devices with a Type-C port.

          If unsure, say N.

config TYPEC_MUX_SUNXI_PHY_SWITCHER
	tristate "Allwinner Mux/Switcher based on external PHY"
	help
	  Say Y or M if switch / mux baed on external PHY for hardware design is need,
	  to manager orientation or mux state for some devices with a Type-C port.

		  If unsure, say N.

endmenu
```
